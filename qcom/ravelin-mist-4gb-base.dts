// SPDX-License-Identifier: BSD-3-Clause

/dts-v1/;

#include "ravelin-mist-base.dtsi"
#include "ravelin-low-memory.dtsi"

/ {
	model = "Xiaomi Mist 4GB";
	compatible = "qcom,ravelin";
	qcom,msm-id = <568 0x10000>, <602 0x10000>, <653 0x10000>, <654 0x10000>;
	qcom,board-id = <0 0x600>;
};

&mem_client_3_size {
	qcom,peripheral-size = <0x200000>;
};
