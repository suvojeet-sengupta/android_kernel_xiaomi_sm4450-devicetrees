// SPDX-License-Identifier: BSD-3-Clause

&battery_charger {
	status = "okay";
	qcom,lpd_enable;
	qcom,thermal-mitigation-step = <500000>;
	qcom,wireless-charging-not-supported;
	qcom,thermal-mitigation = <7500000 7000000 6500000 6000000 5400000
				5000000 4500000 4000000 3700000 3300000 3000000
				2800000 2600000 2300000 1500000 1000000 800000
				550000 500000>;
};
