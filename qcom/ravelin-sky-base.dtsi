// SPDX-License-Identifier: BSD-3-Clause
/*
 * Xiaomi Sky base.
 */

#include "ravelin-xiaomi-common-base.dtsi"
#include "ravelin-xiaomi-legacy-memory.dtsi"

&ufshc_mem {
	/* Stock trustzone doesn't broadcast the HWKM TP key */
	qcom,ice-hwkm-set-tpkey;
};
