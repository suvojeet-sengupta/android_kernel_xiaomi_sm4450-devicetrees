// SPDX-License-Identifier: BSD-3-Clause

&battery_charger {
	status = "okay";
	qcom,wireless-charging-not-supported;
	qcom,shutdown-voltage = <3300>;
	/* XM_PROP_INPUT_SUSPEND in the sky ADSP charger firmware */
	xiaomi,input-suspend-prop = <3>;

	/*
	 * No fixed thermal charge current levels: charge at the full current
	 * the ADSP allows and let smart charging seek the fastest current that
	 * holds the battery at 40 C and the skin (quiet_therm) at 41 C. It
	 * reacts to heat by up to 1 A a tick and eases back on by up to 2 A a
	 * tick, moving 30 mA per 0.1 C of projected headroom, and never charges
	 * below 900 mA.
	 */
	/delete-property/ qcom,thermal-mitigation;
	/delete-property/ qcom,thermal-mitigation-step;
	xiaomi,smart-chg-enable;
	xiaomi,smart-chg-temp = <400>;
	xiaomi,smart-chg-skin-zone = "quiet_therm";
	xiaomi,smart-chg-skin-temp = <410>;
	xiaomi,smart-chg-min-fcc-ua = <900000>;
	xiaomi,smart-chg-down-ua = <1000000>;
	xiaomi,smart-chg-up-ua = <2000000>;
	xiaomi,smart-chg-gain-ua = <30000>;
};
