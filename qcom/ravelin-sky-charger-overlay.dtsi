// SPDX-License-Identifier: BSD-3-Clause

&battery_charger {
	status = "okay";
	qcom,thermal-mitigation-step = <500000>;
	qcom,wireless-charging-not-supported;
	qcom,shutdown-voltage = <3300>;
	qcom,thermal-mitigation = <3500000 3400000 3300000 3200000 3100000
				3000000 2900000 2800000 2700000 2600000 2500000
				2400000 2300000 2200000 2100000 2000000 1900000
				1800000 1700000 1600000 1500000 1400000 1300000
				1200000 1100000 1000000 900000 800000 700000
				600000 500000 400000 300000 200000 100000 50000 0>;
};
