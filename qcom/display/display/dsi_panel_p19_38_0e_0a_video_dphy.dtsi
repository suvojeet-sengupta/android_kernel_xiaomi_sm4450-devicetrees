// SPDX-License-Identifier: BSD-3-Clause

&mdss_mdp {
	dsi_p19_38_0e_0a_video_dphy: qcom,mdss_dsi_p19_38_0e_0a_video_dphy {
		mi,doze-hbm-dbv-level = <0xaa>;
		mi,doze-lbm-dbv-level = <0x11>;
		mi,esd-err-irq-gpio = <&tlmm 0x5d 0x2008>;
		mi,esd-err-irq-gpio-flag = <0x2008>;
		mi,flatmode-status-check-enabled;
		mi,local-hbm-enabled;
		mi,local-hbm-ui-ready-delay-num-frame = <0x03>;
		mi,max-brightness-clone = <0xfff>;
		mi,mdss-dsi-fac-bl-max-level = <0x7ff>;
		mi,mdss-dsi-panel-cell-id-read-after-tx-command = [39 01 00 00 00 00 0b f0 a5 a5 00 00 00 00 00 00 00 00];
		mi,mdss-dsi-panel-cell-id-read-after-tx-command-state = "dsi_lp_mode";
		mi,mdss-dsi-panel-cell-id-read-command = <0x6010001 0x1d8>;
		mi,mdss-dsi-panel-cell-id-read-command-state = "dsi_lp_mode";
		mi,mdss-dsi-panel-cell-id-read-length = <0x08>;
		mi,mdss-dsi-panel-cell-id-read-offset1-command = [39 01 00 00 00 00 04 b0 00 12 d8];
		mi,mdss-dsi-panel-cell-id-read-offset1-command-state = "dsi_lp_mode";
		mi,mdss-dsi-panel-cell-id-read-offset2-command = [39 01 00 00 00 00 04 b0 00 1a d8];
		mi,mdss-dsi-panel-cell-id-read-offset2-command-state = "dsi_lp_mode";
		mi,mdss-dsi-panel-cell-id-read-pre-tx-command = [39 01 00 00 00 00 0b f0 5a 5a 00 00 00 00 00 00 00 00];
		mi,mdss-dsi-panel-cell-id-read-pre-tx-command-state = "dsi_lp_mode";
		mi,mdss-dsi-panel-flatmode-on-status-value = <0x29>;
		mi,mdss-dsi-panel-flatmode-status-command = <0x6010001 0x16a>;
		mi,mdss-dsi-panel-flatmode-status-command-state = "dsi_lp_mode";
		mi,mdss-dsi-panel-flatmode-status-offset-command = [39 01 00 40 00 00 0b f0 5a 5a 00 00 00 00 00 00 00 00 39 01 00 00 00 00 04 b0 00 03 6a];
		mi,mdss-dsi-panel-flatmode-status-offset-command-state = "dsi_lp_mode";
		mi,mdss-dsi-panel-flatmode-status-offset-end-command = [39 01 00 00 00 00 0b f0 a5 a5 00 00 00 00 00 00 00 00];
		mi,mdss-dsi-panel-flatmode-status-offset-end-command-state = "dsi_lp_mode";
		mi,mdss-dsi-panel-flatmode-status-read-length = <0x01>;
		mi,mdss-fac-brightness-max-level = <0x7ff>;
		mi,normal-max-brightness-clone = <0x7ff>;
		qcom,bl-dsc-cmd-state = "dsi_lp_mode";
		qcom,dsi-ctrl-num = <0x00>;
		qcom,dsi-phy-num = <0x00>;
		qcom,dsi-select-clocks = "pll_byte_clk0", "pll_dsi_clk0";
		qcom,dsi-supported-dfps-list = <0x78 0x5a 0x3c>;
		qcom,esd-check-enabled;
		qcom,mdss-brightness-init-level = <0x109>;
		/* Stock caps normal brightness at DBV 2047 (fac level), the rest is HBM */
		qcom,mdss-brightness-max-level = <2047>;
		qcom,mdss-dsi-bl-inverted-dbv;
		qcom,mdss-dsi-bl-max-level = <2047>;
		qcom,mdss-dsi-bl-min-level = <0x05>;
		qcom,mdss-dsi-bl-pmic-control-type = "bl_ctrl_dcs";
		qcom,mdss-dsi-bllp-eof-power-mode;
		qcom,mdss-dsi-bllp-power-mode;
		qcom,mdss-dsi-border-color = <0x00>;
		qcom,mdss-dsi-bpp = <0x18>;
		qcom,mdss-dsi-dma-schedule-line = <0x04>;
		qcom,mdss-dsi-dma-trigger = "trigger_sw";
		qcom,mdss-dsi-lane-0-state;
		qcom,mdss-dsi-lane-1-state;
		qcom,mdss-dsi-lane-2-state;
		qcom,mdss-dsi-lane-3-state;
		qcom,mdss-dsi-mdp-trigger = "none";
		qcom,mdss-dsi-pan-enable-dynamic-fps;
		qcom,mdss-dsi-pan-fps-update = "dfps_immediate_porch_mode_vfp";
		qcom,mdss-dsi-panel-name = "p19 38 0e 0a dphy AMS699MM01 SDC";
		qcom,mdss-dsi-panel-physical-type = "oled";
		qcom,mdss-dsi-panel-status-check-mode = "reg_read";
		qcom,mdss-dsi-panel-status-command = <0x6010001 0x19e>;
		qcom,mdss-dsi-panel-status-command-state = "dsi_hs_mode";
		qcom,mdss-dsi-panel-status-read-length = <0x02>;
		qcom,mdss-dsi-panel-status-value = <0x11 0x00>;
		qcom,mdss-dsi-panel-type = "dsi_video_mode";
		qcom,mdss-dsi-reset-sequence = <0x01 0x02 0x00 0x02 0x01 0x0a>;
		qcom,mdss-dsi-stream = <0x00>;
		qcom,mdss-dsi-traffic-mode = "burst_mode";
		qcom,mdss-dsi-virtual-channel-id = <0x00>;
		qcom,mdss-pan-physical-height-dimension = <0xa2>;
		qcom,mdss-pan-physical-width-dimension = <0x49>;
		qcom,platform-dvdd-gpio = <&tlmm 0x3c 0x00>;
		qcom,platform-reset-gpio = <&tlmm 0x5c 0x00>;
		qcom,platform-vci-gpio = <&tlmm 0x39 0x00>;
		qcom,platform-vddio-gpio = <&tlmm 0x5f 0x00>;
		qcom,mdss-dsi-display-timings {
			timing@0 {
				cell-index = <0x00>;
				mi,mdss-dsi-dimmingoff-command = [39 01 00 00 00 00 02 53 20];
				mi,mdss-dsi-dimmingoff-command-state = "dsi_lp_mode";
				mi,mdss-dsi-dimmingon-command = [39 01 00 00 00 00 02 53 28];
				mi,mdss-dsi-dimmingon-command-state = "dsi_lp_mode";
				mi,mdss-dsi-displayoff-command = [39 01 00 00 00 00 02 53 00];
				mi,mdss-dsi-displayoff-command-state = "dsi_lp_mode";
				mi,mdss-dsi-flat-mode-off-command = <0x39010000 0xbf0 0x5a5a0000 0x00 0x3901 0x00 0x4b00003 0x6a390100 0x02 0x6a093901 0x00 0xbf0a5a5 0x00 0x00>;
				mi,mdss-dsi-flat-mode-off-command-state = "dsi_lp_mode";
				mi,mdss-dsi-flat-mode-on-command = <0x39010000 0xbf0 0x5a5a0000 0x00 0x3901 0x00 0x4b00003 0x6a390100 0x02 0x6a293901 0x00 0xbf0a5a5 0x00 0x00>;
				mi,mdss-dsi-flat-mode-on-command-state = "dsi_lp_mode";
				mi,mdss-dsi-hbm-on-command = [39 01 00 00 00 00 03 51 0f ff];
				mi,mdss-dsi-hbm-on-command-state = "dsi_hs_mode";
				mi,mdss-dsi-local-hbm-hlpm-white-1000nit-command = [39 01 00 40 00 00 0b f0 5a 5a 00 00 00 00 00 00 00 00 15 01 00 40 00 00 02 53 24 39 01 00 40 00 00 04 b0 03 3b 66 15 01 00 40 00 00 02 66 11 39 01 00 40 00 00 04 b0 03 3c 66 39 01 00 40 00 00 0d 66 09 e6 08 ac 0b 15 09 e6 08 ac 0b 15 15 01 00 40 00 00 02 f7 07 15 01 00 40 00 00 02 f7 07 15 01 00 40 00 00 02 f7 07 39 01 00 00 00 00 0b f0 a5 a5 00 00 00 00 00 00 00 00];
				mi,mdss-dsi-local-hbm-hlpm-white-1000nit-command-state = "dsi_hs_mode";
				mi,mdss-dsi-local-hbm-hlpm-white-110nit-command = [39 01 00 40 00 00 0b f0 5a 5a 00 00 00 00 00 00 00 00 15 01 00 40 00 00 02 53 24 39 01 00 40 00 00 04 b0 03 3b 66 15 01 00 40 00 00 02 66 11 39 01 00 40 00 00 04 b0 03 3c 66 39 01 00 40 00 00 0d 66 07 f0 06 ef 08 ed 07 f0 06 ef 08 ed 15 01 00 40 00 00 02 f7 07 15 01 00 40 00 00 02 f7 07 15 01 00 40 00 00 02 f7 07 39 01 00 00 00 00 0b f0 a5 a5 00 00 00 00 00 00 00 00];
				mi,mdss-dsi-local-hbm-hlpm-white-110nit-command-state = "dsi_hs_mode";
				mi,mdss-dsi-local-hbm-normal-white-1000nit-command = [39 01 00 40 00 00 0b f0 5a 5a 00 00 00 00 00 00 00 00 15 01 00 40 00 00 02 53 24 39 01 00 40 00 00 04 b0 03 3b 66 15 01 00 40 00 00 02 66 11 39 01 00 40 00 00 04 b0 03 3c 66 39 01 00 40 00 00 0d 66 09 e6 08 ac 0b 15 09 e6 08 ac 0b 15 15 01 00 40 00 00 02 f7 07 15 01 00 40 00 00 02 f7 07 15 01 00 40 00 00 02 f7 07 39 01 00 00 00 00 0b f0 a5 a5 00 00 00 00 00 00 00 00];
				mi,mdss-dsi-local-hbm-normal-white-1000nit-command-state = "dsi_hs_mode";
				mi,mdss-dsi-local-hbm-normal-white-110nit-command = [39 01 00 40 00 00 0b f0 5a 5a 00 00 00 00 00 00 00 00 15 01 00 40 00 00 02 53 24 39 01 00 40 00 00 04 b0 03 3b 66 15 01 00 40 00 00 02 66 11 39 01 00 40 00 00 04 b0 03 3c 66 39 01 00 40 00 00 0d 66 07 f0 06 ef 08 ed 07 f0 06 ef 08 ed 15 01 00 40 00 00 02 f7 07 15 01 00 40 00 00 02 f7 07 15 01 00 40 00 00 02 f7 07 39 01 00 00 00 00 0b f0 a5 a5 00 00 00 00 00 00 00 00];
				mi,mdss-dsi-local-hbm-normal-white-110nit-command-state = "dsi_hs_mode";
				mi,mdss-dsi-local-hbm-off-to-normal-command = [39 01 00 40 00 00 0b f0 5a 5a 00 00 00 00 00 00 00 00 15 01 00 40 00 00 02 53 20 39 01 00 40 00 00 04 b0 03 3b 66 15 01 00 40 00 00 02 66 01 39 01 00 40 00 00 04 b0 03 3c 66 39 01 00 40 00 00 0d 66 0a ff 0a fe 0a fd 0a fc 0a fb 0a fa 15 01 00 40 00 00 02 f7 07 15 01 00 40 00 00 02 f7 07 15 01 00 40 00 00 02 f7 07 39 01 00 00 00 00 0b f0 a5 a5 00 00 00 00 00 00 00 00];
				mi,mdss-dsi-local-hbm-off-to-normal-command-state = "dsi_hs_mode";
				mi,mdss-dsi-peak-mode-off-command = <0x39010040 0xbf0 0x5a5a0000 0x00 0x3901 0x400000 0x4b00001 0x6a390100 0x40000002 0x6a003901 0x400000 0x4b00010 0x6a390100 0x40000007 0x6a7571d7 0x26262639 0x1004000 0x4b000 0x776a3901 0x400000 0x36a0000 0x15010040 0x2f7 0x7150100 0x40000002 0xf7073901 0x00 0xbf0a5a5 0x00 0x00>;
				mi,mdss-dsi-peak-mode-off-command-state = "dsi_hs_mode";
				mi,mdss-dsi-peak-mode-on-command = <0x39010040 0xbf0 0x5a5a0000 0x00 0x3901 0x400000 0x4b00001 0x6a390100 0x40000002 0x6a023901 0x400000 0x4b00010 0x6a390100 0x40000007 0x6a6f6fdf 0x23232339 0x1004000 0x4b000 0x776a3901 0x400000 0x36ab994 0x15010040 0x2f7 0x7150100 0x40000002 0xf7073901 0x00 0xbf0a5a5 0x00 0x00>;
				mi,mdss-dsi-peak-mode-on-command-state = "dsi_hs_mode";
				qcom,compression-mode = "dsc";
				qcom,default-topology-index = <0x00>;
				qcom,display-topology = <0x01 0x01 0x01>;
				qcom,mdss-dsc-bit-per-component = <0x08>;
				qcom,mdss-dsc-bit-per-pixel = <0x08>;
				qcom,mdss-dsc-block-prediction-enable;
				qcom,mdss-dsc-scr-version = <0x00>;
				qcom,mdss-dsc-slice-height = <0x257>;
				qcom,mdss-dsc-slice-per-pkt = <0x02>;
				qcom,mdss-dsc-slice-width = <0x21c>;
				qcom,mdss-dsc-version = <0x11>;
				qcom,mdss-dsi-dispparam-120hz-command = [39 01 00 40 00 00 0b f0 5a 5a 00 00 00 00 00 00 00 00 15 01 00 40 00 00 02 60 00 39 01 00 40 00 00 04 b0 00 2a c9 39 01 00 40 00 00 05 c9 00 0a 00 0a 39 01 00 40 00 00 04 b0 01 35 66 39 01 00 40 00 00 21 66 09 80 09 50 09 10 08 a0 08 38 07 c8 06 f0 06 18 05 38 04 60 03 88 02 b0 01 00 00 20 00 20 00 20 39 01 00 40 00 00 04 b0 01 61 66 39 01 00 40 00 00 21 66 09 80 09 50 09 10 08 a0 08 38 07 c8 06 f0 06 18 05 38 04 60 03 88 02 b0 01 00 00 20 00 20 00 20 15 01 00 40 00 00 02 f7 0f 39 01 00 00 00 00 0b f0 a5 a5 00 00 00 00 00 00 00 00];
				qcom,mdss-dsi-dispparam-120hz-command-state = "dsi_hs_mode";
				qcom,mdss-dsi-dispparam-60hz-command = [39 01 00 40 00 00 0b f0 5a 5a 00 00 00 00 00 00 00 00 15 01 00 40 00 00 02 60 01 39 01 00 40 00 00 04 b0 00 2a c9 39 01 00 40 00 00 05 c9 00 0a 00 0a 39 01 00 40 00 00 04 b0 01 35 66 39 01 00 40 00 00 21 66 09 80 09 50 09 10 08 a0 08 38 07 c8 06 f0 06 18 05 38 04 60 03 88 02 b0 01 00 00 20 00 20 00 20 39 01 00 40 00 00 04 b0 01 61 66 39 01 00 40 00 00 21 66 09 80 09 50 09 10 08 a0 08 38 07 c8 06 f0 06 18 05 38 04 60 03 88 02 b0 01 00 00 20 00 20 00 20 15 01 00 40 00 00 02 f7 0f 39 01 00 00 00 00 0b f0 a5 a5 00 00 00 00 00 00 00 00];
				qcom,mdss-dsi-dispparam-60hz-command-state = "dsi_hs_mode";
				qcom,mdss-dsi-dispparam-90hz-command = [39 01 00 40 00 00 0b f0 5a 5a 00 00 00 00 00 00 00 00 15 01 00 40 00 00 02 60 00 39 01 00 40 00 00 04 b0 00 2a c9 39 01 00 40 00 00 05 c9 03 2a 03 2a 39 01 00 40 00 00 04 b0 01 35 66 39 01 00 40 00 00 21 66 0c a0 0c 60 0c 0a 0b 78 0a ec 0a 58 09 38 08 10 06 f0 05 d0 04 b2 03 8a 01 58 00 2b 00 2b 00 2b 39 01 00 40 00 00 04 b0 01 61 66 39 01 00 40 00 00 21 66 0c a0 0c 60 0c 0a 0b 78 0a ec 0a 58 09 38 08 10 06 f0 05 d0 04 b2 03 8a 01 58 00 2b 00 2b 00 2b 15 01 00 40 00 00 02 f7 0f 39 01 00 00 00 00 0b f0 a5 a5 00 00 00 00 00 00 00 00];
				qcom,mdss-dsi-dispparam-90hz-command-state = "dsi_hs_mode";
				qcom,mdss-dsi-dispparam-hbm-on-l1-command = [39 01 00 40 00 00 0b f0 5a 5a 00 00 00 00 00 00 00 00 39 01 00 40 00 00 0b f1 5a 5a 00 00 00 00 00 00 00 00 39 01 00 40 00 00 03 51 08 00 39 01 00 40 00 00 04 b0 00 5f f4 15 01 00 40 00 00 02 f4 0c 15 01 00 40 00 00 02 f7 07 15 01 00 40 00 00 02 f7 07 15 01 00 40 00 00 02 f7 07 39 01 00 40 00 00 0b f1 a5 a5 00 00 00 00 00 00 00 00 39 01 00 00 00 00 0b f0 a5 a5 00 00 00 00 00 00 00 00];
				qcom,mdss-dsi-dispparam-hbm-on-l1-command-state = "dsi_hs_mode";
				qcom,mdss-dsi-h-back-porch = <0x88>;
				qcom,mdss-dsi-h-front-porch = <0x64>;
				qcom,mdss-dsi-h-left-border = <0x00>;
				qcom,mdss-dsi-h-pulse-width = <0x22>;
				qcom,mdss-dsi-h-right-border = <0x00>;
				qcom,mdss-dsi-h-sync-skew = <0x00>;
				qcom,mdss-dsi-on-command = <0x39010000 0xb9f 0x5a5a0000 0x00 0x3901 0x00 0xbf05a5a 0x00 0x00 0x39010000 0xbfc 0x5a5a0000 0x00 0x3901 0x00 0x3d00100 0x39010000 0x4b0 0x42c339 0x1000000 0x10c30b 0x10a 0x1a000b 0x10a 0x1a3901 0x00 0x4b0008f 0xc3150100 0x02 0xc3153901 0x00 0x4b0013d 0xc3390100 0x10 0xc39e8a00 0x9e000e2f 0x464100 0x15 0x39010000 0x4b0 0x1f9c339 0x1000000 0x5c39e 0x8a009e39 0x1000000 0x4b000 0x10f63901 0x00 0x5f6001b 0x1b3901 0x00 0x4b00028 0xc9390100 0x21 0xc9095c00 0xa000a1a 0x1a04383e 0x3e161600 0xa001a3e 0x16000a00 0x1a3e1600 0xa001a16 0x16390100 0x03 0xd0010039 0x1000000 0x4b000 0x53cd3901 0x00 0x2cd0805 0x1000064 0x11139 0x1000000 0x4b003 0x48663901 0x00 0x65665d55 0x5b5d555b 0x5d555b5d 0x555b5d55 0x5b5d565c 0x5d565c68 0x636c776f 0x7d82798a 0x82798a82 0x798a8279 0x8a82798a 0x82798a82 0x798a8279 0x8a82798a 0x82798a82 0x798a8279 0x8a82798a 0x82798a82 0x798a5d55 0x5a5d555a 0x5d555a5d 0x565b5d55 0x5a5b5358 0x5b53584e 0x4c515c56 0x60563901 0x00 0x4b003ac 0x66390100 0x55 0x66515d56 0x515d5651 0x5d56515d 0x56515d56 0x515d5651 0x5d56515d 0x56515d56 0x515d5651 0x5d56515d 0x56515d56 0x515d5651 0x5d5d555a 0x5d555a5d 0x555a5c54 0x595b5358 0x584f5457 0x4d523131 0x31403b42 0x26232c26 0x232c2623 0x2c26232c 0x26390100 0x65 0x67232c26 0x232c2623 0x2c26232c 0x26232c26 0x232c2623 0x2c26232c 0x26232c26 0x232c2623 0x2c5e585d 0x5d585d5d 0x585d5d58 0x5d5e595e 0x5e595e5e 0x5a5e6765 0x6d787380 0x827b8c82 0x7b8c827b 0x8c827b8c 0x827b8c82 0x7b8c827b 0x8c827b8c 0x827b8c82 0x7b8c827b 0x8c827b8c 0x827b8c82 0x7b390100 0x04 0xb0006467 0x39010000 0x6567 0x8c827b8c 0x5d585c5e 0x595d5e59 0x5d5d585c 0x5d585c5c 0x565b5c56 0x5a4e4e52 0x5e5b6457 0x54605754 0x60575460 0x57546057 0x54605754 0x60575460 0x57546057 0x54605754 0x60575460 0x57546057 0x54605754 0x60575460 0x5d585c5e 0x595d5e59 0x5d5d585c 0x5d565b5a 0x53575750 0x54333334 0x39010000 0x4b0 0xc86739 0x1000000 0x316742 0x3f462827 0x30282730 0x28273028 0x27302827 0x30282730 0x28273028 0x27302827 0x30282730 0x28273028 0x27302827 0x30282730 0x28273039 0x1000000 0x28f0a 0x39010000 0x4b0 0x48f39 0x1000000 0x28faf 0x39010000 0x10015c7 0x3950347 0x3c206fc 0x55c0562 0x1f0103 0x10445122 0x39010000 0xced 0xff0000 0xff000004 0x415 0x1000000 0x26000 0x15010000 0x2f7 0xf150100 0x02 0x53283901 0x00 0x4b00010 0x66150100 0x02 0x66013901 0x00 0x4b00012 0x66150100 0x02 0x66083901 0x00 0x3510000 0x15010000 0x2f7 0xf150100 0x02 0x9d013901 0x00 0x5a9e1100 0x893080 0x95c0438 0x257021c 0x21c0200 0x2520020 0x339e0007 0xf0034 0x2c1800 0x10f0030c 0x2000060b 0xb330e1c 0x2a384654 0x62697077 0x797b7d7e 0x1020100 0x94009be 0x19fc19fa 0x19f81a38 0x1a781ab6 0x2ab62af4 0x2af44b34 0x63740015 0x1000014 0x23500 0x5010000 0x14000129>;
				qcom,mdss-dsi-on-command-state = "dsi_lp_mode";
				qcom,mdss-dsi-panel-framerate = <0x78>;
				qcom,mdss-dsi-panel-height = <0x95c>;
				qcom,mdss-dsi-panel-phy-timings = [00 24 0a 0a 1a 18 0a 0a 09 02 04 00 1e 0f];
				qcom,mdss-dsi-panel-width = <0x438>;
				qcom,mdss-dsi-pre-off-command = [05 01 00 00 14 00 02 28 00 05 01 00 00 78 00 02 10 00];
				qcom,mdss-dsi-pre-off-command-state = "dsi_lp_mode";
				qcom,mdss-dsi-v-back-porch = <0x18>;
				qcom,mdss-dsi-v-bottom-border = <0x00>;
				qcom,mdss-dsi-v-front-porch = <0x0a>;
				qcom,mdss-dsi-v-pulse-width = <0x02>;
				qcom,mdss-dsi-v-top-border = <0x00>;
			};
		};
	};
};
