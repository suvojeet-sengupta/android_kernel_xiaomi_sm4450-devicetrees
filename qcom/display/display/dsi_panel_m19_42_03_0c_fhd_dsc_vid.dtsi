&mdss_mdp {
	dsi_m19_42_03_0c_fhd_dsc_vid: qcom,mdss_dsi_m19_42_03_0c_fhd_dsc_vid {
				qcom,platform-reset-gpio = <&tlmm>, <0x5c 0x00>;
				qcom,mdss-brightness-max-level = <0x7ff>;
				qcom,mdss-dsi-bl-max-level = <0x7ff>;
				qcom,mdss-dsi-bl-min-level = <0x01>;
				qcom,mdss-dsi-bl-pmic-control-type = "bl_ctrl_i2c";
				qcom,panel-supply-entries = <&dsi_panel_pwr_supply_sim>;
				qcom,mdss-dsi-panel-status-read-length = <0x01>;
				qcom,mdss-dsi-panel-status-value = <0x9c>;
				qcom,mdss-dsi-panel-status-command-state = "dsi_lp_mode";
				qcom,mdss-dsi-panel-status-command = <0x6010001 0x10a>;
				qcom,mdss-dsi-panel-status-check-mode = "reg_read";
				qcom,esd-check-enabled;
				qcom,mdss-dsi-t-clk-pre = <0x15>;
				qcom,mdss-dsi-t-clk-post = <0x0b>;
				qcom,dispparam-enabled;
				qcom,mdss-dsi-pan-fps-update = "dfps_immediate_porch_mode_vfp";
				qcom,mdss-dsi-pan-enable-dynamic-fps;
				qcom,dsi-supported-dfps-list = <0x5a 0x3c 0x31 0x1e>;
				qcom,dsi-select-clocks = "pll_byte_clk0", "pll_dsi_clk0";
				qcom,mdss-pan-physical-height-dimension = <0x9e>;
				qcom,mdss-pan-physical-width-dimension = <0x45>;
				qcom,mdss-dsi-reset-sequence = <0x00 0x01 0x01 0x04 0x00 0x01 0x01 0x0c>;
				qcom,mdss-dsi-lp11-init;
				qcom,mdss-dsi-mdp-trigger = "none";
				qcom,mdss-dsi-dma-trigger = "trigger_sw";
				qcom,mdss-dsi-lane-3-state;
				qcom,mdss-dsi-lane-2-state;
				qcom,mdss-dsi-lane-1-state;
				qcom,mdss-dsi-lane-0-state;
				qcom,mdss-dsi-bllp-eof-power-mode;
				qcom,mdss-dsi-bllp-power-mode;
				qcom,mdss-dsi-traffic-mode = "burst_mode";
				qcom,mdss-dsi-bpp = <0x18>;
				qcom,mdss-dsi-stream = <0x00>;
				qcom,mdss-dsi-virtual-channel-id = <0x00>;
				qcom,dsi-phy-num = <0x00>;
				qcom,dsi-ctrl-num = <0x00>;
				qcom,mdss-dsi-panel-type = "dsi_video_mode";
				qcom,mdss-dsi-panel-name = "xiaomi_m19_42_03_0c_fhd_dsc_video_dsi_panel";

				qcom,mdss-dsi-display-timings {

					timing@0 {
						qcom,default-topology-index = <0x00>;
						qcom,display-topology = <0x01 0x01 0x01>;
						qcom,mdss-dsi-panel-phy-timings = [00 18 06 06 15 20 06 06 07 02 04 00 15 0b];
						qcom,mdss-dsc-block-prediction-enable;
						qcom,mdss-dsc-bit-per-pixel = <0x08>;
						qcom,mdss-dsc-bit-per-component = <0x08>;
						qcom,mdss-dsc-slice-per-pkt = <0x02>;
						qcom,mdss-dsc-slice-width = <0x21c>;
						qcom,mdss-dsc-slice-height = <0x14>;
						qcom,compression-mode = "dsc";
						qcom,proximity_pre-off-command-state = "dsi_lp_mode";
						qcom,proximity_pre-off-command = <0x5010000 0x23000128>;
						qcom,mdss-dsi-cabc-off-command-state = "dsi_lp_mode";
						qcom,mdss-dsi-cabc-off-command = [39 01 00 00 00 00 02 55 00];
						qcom,mdss-dsi-cabc-movie-on-command-state = "dsi_lp_mode";
						qcom,mdss-dsi-cabc-movie-on-command = [39 01 00 00 00 00 02 55 03];
						qcom,mdss-dsi-cabc-still-on-command-state = "dsi_lp_mode";
						qcom,mdss-dsi-cabc-still-on-command = [39 01 00 00 00 00 02 55 02];
						qcom,mdss-dsi-cabc-ui-on-command-state = "dsi_lp_mode";
						qcom,mdss-dsi-cabc-ui-on-command = [39 01 00 00 00 00 02 55 01];
						qcom,mdss-dsi-off-command-state = "dsi_lp_mode";
						qcom,mdss-dsi-off-command = [39 01 00 00 00 00 02 00 00 39 01 00 00 00 00 04 ff 87 25 01 39 01 00 00 00 00 02 00 80 39 01 00 00 00 00 03 ff 87 25 05 01 00 00 23 00 01 28 05 01 00 00 96 00 01 10 39 01 00 00 00 00 02 00 00 39 01 00 00 00 00 05 f7 5a a5 95 27 39 01 00 00 00 00 02 00 00 39 01 00 00 00 00 04 ff 00 00 00 39 01 00 00 00 00 02 00 80 39 01 00 00 14 00 03 ff 00 00];
						qcom,mdss-dsi-on-command-state = "dsi_lp_mode";
						qcom,mdss-dsi-on-command = [39 01 00 00 00 00 02 00 00 39 01 00 00 00 00 04 ff 87 25 01 39 01 00 00 00 00 02 00 80 39 01 00 00 00 00 03 ff 87 25 39 01 00 00 00 00 02 00 b0 39 01 00 00 00 00 0f b4 00 14 02 00 01 e8 00 07 05 0e 05 16 10 f0 39 01 00 00 00 00 02 00 b0 39 01 00 00 00 00 07 ca 02 02 0b 0f ff 08 39 01 00 00 00 00 02 00 80 39 01 00 00 00 00 0d ca e6 d1 c0 b4 aa a1 9a 94 8f 8a 86 82 39 01 00 00 00 00 02 00 90 39 01 00 00 00 00 0a ca fe ff 66 f5 ff ad fa ff d6 39 01 00 00 00 00 02 00 a0 39 01 00 00 00 00 04 ca 06 06 07 39 01 00 00 00 00 02 00 0e 39 01 00 00 00 00 03 f3 80 ff 39 01 00 00 00 00 02 00 00 39 01 00 00 00 00 04 ff 00 00 00 39 01 00 00 00 00 02 00 80 39 01 00 00 00 00 03 ff 00 00 39 01 00 00 00 00 03 51 ff 0e 39 01 00 00 00 00 02 55 00 39 01 00 00 00 00 02 53 2c 39 01 00 00 00 00 02 35 00 05 01 00 00 78 00 01 11 05 01 00 00 00 00 01 29];
						qcom,mdss-dsi-panel-framerate = <0x5a>;
						qcom,mdss-dsi-v-pulse-width = <0x0a>;
						qcom,mdss-dsi-v-front-porch = <0x0a>;
						qcom,mdss-dsi-v-back-porch = <0x14>;
						qcom,mdss-dsi-h-sync-skew = <0x00>;
						qcom,mdss-dsi-h-pulse-width = <0x08>;
						qcom,mdss-dsi-h-back-porch = <0x38>;
						qcom,mdss-dsi-h-front-porch = <0x4c>;
						qcom,mdss-dsi-panel-height = <0x99c>;
						qcom,mdss-dsi-panel-width = <0x438>;
					};
				};
			};
		};
