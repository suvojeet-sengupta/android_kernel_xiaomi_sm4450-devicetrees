// SPDX-License-Identifier: BSD-3-Clause

&mdss_mdp {
	dsi_n19_36_02_0c_fhd_dsc_vid: qcom,mdss_dsi_n19_36_02_0c_fhd_dsc_vid {
		qcom,dsi-ctrl-num = <0x00>;
		qcom,dsi-phy-num = <0x00>;
		qcom,dsi-select-clocks = "pll_byte_clk0", "pll_dsi_clk0";
		qcom,dsi-supported-dfps-list = <0x78 0x5a 0x3c 0x32 0x30 0x2d 0x28 0x1e>;
		qcom,esd-check-enabled;
		/* Stock maps 0-2047 linearly to DBV 0-1435 (450 nits), the rest is HBM */
		qcom,mdss-brightness-max-level = <2047>;
		qcom,mdss-dsi-bl-inverted-dbv;
		qcom,mdss-dsi-bl-max-level = <1435>;
		qcom,mdss-dsi-bl-min-level = <0x08>;
		qcom,mdss-dsi-bl-pmic-control-type = "bl_ctrl_dcs";
		qcom,mdss-dsi-bllp-eof-power-mode;
		qcom,mdss-dsi-bllp-power-mode;
		qcom,mdss-dsi-bpp = <0x18>;
		qcom,mdss-dsi-dma-trigger = "trigger_sw";
		qcom,mdss-dsi-lane-0-state;
		qcom,mdss-dsi-lane-1-state;
		qcom,mdss-dsi-lane-2-state;
		qcom,mdss-dsi-lane-3-state;
		qcom,mdss-dsi-lp11-init;
		qcom,mdss-dsi-mdp-trigger = "none";
		qcom,mdss-dsi-pan-enable-dynamic-fps;
		qcom,mdss-dsi-pan-fps-update = "dfps_immediate_porch_mode_vfp";
		qcom,mdss-dsi-panel-name = "xiaomi_n19_36_02_0c_fhd_dsc_video_dsi_panel";
		qcom,mdss-dsi-panel-status-check-mode = "reg_read";
		qcom,mdss-dsi-panel-status-command = <0x6010001 0x10a>;
		qcom,mdss-dsi-panel-status-command-state = "dsi_lp_mode";
		qcom,mdss-dsi-panel-status-read-length = <0x01>;
		qcom,mdss-dsi-panel-status-value = <0x9c>;
		qcom,mdss-dsi-panel-type = "dsi_video_mode";
		qcom,mdss-dsi-reset-sequence = <0x01 0x14 0x00 0x05 0x01 0x05 0x00 0x05 0x01 0x0a>;
		qcom,mdss-dsi-stream = <0x00>;
		qcom,mdss-dsi-t-clk-post = <0x0d>;
		qcom,mdss-dsi-t-clk-pre = <0x1a>;
		qcom,mdss-dsi-traffic-mode = "burst_mode";
		qcom,mdss-dsi-virtual-channel-id = <0x00>;
		qcom,mdss-pan-physical-height-dimension = <0x9e>;
		qcom,mdss-pan-physical-width-dimension = <0x45>;
		qcom,panel-supply-entries = <&dsi_panel_pwr_supply_sim>;
		qcom,platform-reset-gpio = <&tlmm 0x5c 0x00>;
		qcom,platform-reset-gpio-always-on;
		qcom,mdss-dsi-display-timings {
			timing@0 {
				qcom,compression-mode = "dsc";
				qcom,default-topology-index = <0x00>;
				qcom,display-topology = <0x01 0x01 0x01>;
				qcom,mdss-dsc-bit-per-component = <0x08>;
				qcom,mdss-dsc-bit-per-pixel = <0x08>;
				qcom,mdss-dsc-block-prediction-enable;
				qcom,mdss-dsc-slice-height = <0x14>;
				qcom,mdss-dsc-slice-per-pkt = <0x02>;
				qcom,mdss-dsc-slice-width = <0x21c>;
				qcom,mdss-dsi-cabc-movie-on-command = [39 01 00 00 00 00 02 ff 10 39 01 00 00 00 00 02 fb 01 39 01 00 00 00 00 02 55 03];
				qcom,mdss-dsi-cabc-movie-on-command-state = "dsi_lp_mode";
				qcom,mdss-dsi-cabc-off-command = [39 01 00 00 00 00 02 ff 10 39 01 00 00 00 00 02 fb 01 39 01 00 00 00 00 02 55 00];
				qcom,mdss-dsi-cabc-off-command-state = "dsi_lp_mode";
				qcom,mdss-dsi-cabc-still-on-command = [39 01 00 00 00 00 02 ff 10 39 01 00 00 00 00 02 fb 01 39 01 00 00 00 00 02 55 02];
				qcom,mdss-dsi-cabc-still-on-command-state = "dsi_lp_mode";
				qcom,mdss-dsi-cabc-ui-on-command = [39 01 00 00 00 00 02 ff 10 39 01 00 00 00 00 02 fb 01 39 01 00 00 00 00 02 55 01];
				qcom,mdss-dsi-cabc-ui-on-command-state = "dsi_lp_mode";
				qcom,mdss-dsi-h-back-porch = <0x60>;
				qcom,mdss-dsi-h-front-porch = <0x2c>;
				qcom,mdss-dsi-h-pulse-width = <0x04>;
				qcom,mdss-dsi-h-sync-skew = <0x00>;
				qcom,mdss-dsi-off-command = [39 01 00 00 28 00 03 51 00 00 05 01 00 00 14 00 01 28 05 01 00 00 78 00 01 10];
				qcom,mdss-dsi-off-command-state = "dsi_lp_mode";
				qcom,mdss-dsi-on-command = [39 01 00 00 00 00 02 ff 10 39 01 00 00 00 00 02 fb 01 39 01 00 00 00 00 06 3b 03 14 36 04 04 39 01 00 00 00 00 02 b0 00 39 01 00 00 00 00 03 c2 1b a0 39 01 00 00 00 00 02 e9 01 39 01 00 00 00 00 02 ff 25 39 01 00 00 00 00 02 fb 01 39 01 00 00 00 00 02 18 20 39 01 00 00 00 00 02 ff e0 39 01 00 00 00 00 02 fb 01 39 01 00 00 00 00 02 35 82 39 01 00 00 00 00 02 ff f0 39 01 00 00 00 00 02 fb 01 39 01 00 00 00 00 02 1c 01 39 01 00 00 00 00 02 33 01 39 01 00 00 00 00 02 5a 00 39 01 00 00 00 00 02 9c 17 39 01 00 00 00 00 02 ff d0 39 01 00 00 00 00 02 fb 01 39 01 00 00 00 00 02 53 22 39 01 00 00 00 00 02 54 02 39 01 00 00 00 00 02 ff c0 39 01 00 00 00 00 02 fb 01 39 01 00 00 00 00 02 9c 11 39 01 00 00 00 00 02 9d 11 39 01 00 00 00 00 02 ff 23 39 01 00 00 00 00 02 fb 01 39 01 00 00 00 00 02 00 60 39 01 00 00 00 00 02 01 84 39 01 00 00 00 00 02 05 2d 39 01 00 00 00 00 02 06 01 39 01 00 00 00 00 02 07 40 39 01 00 00 00 00 02 08 01 39 01 00 00 00 00 02 09 55 39 01 00 00 00 00 02 0a b2 39 01 00 00 00 00 02 0b b2 39 01 00 00 00 00 02 0c 7b 39 01 00 00 00 00 02 0d 00 39 01 00 00 00 00 02 11 01 39 01 00 00 00 00 02 12 9f 39 01 00 00 00 00 02 15 65 39 01 00 00 00 00 02 16 0b 39 01 00 00 00 00 02 19 13 39 01 00 00 00 00 02 1a 13 39 01 00 00 00 00 02 1b 13 39 01 00 00 00 00 02 1c 13 39 01 00 00 00 00 02 1d 13 39 01 00 00 00 00 02 1e 16 39 01 00 00 00 00 02 1f 18 39 01 00 00 00 00 02 20 1a 39 01 00 00 00 00 02 21 20 39 01 00 00 00 00 02 22 20 39 01 00 00 00 00 02 23 25 39 01 00 00 00 00 02 24 29 39 01 00 00 00 00 02 25 2e 39 01 00 00 00 00 02 26 32 39 01 00 00 00 00 02 27 37 39 01 00 00 00 00 02 28 3c 39 01 00 00 00 00 02 29 0d 39 01 00 00 00 00 02 2a 3f 39 01 00 00 00 00 02 2b 3f 39 01 00 00 00 00 02 30 ff 39 01 00 00 00 00 02 31 fe 39 01 00 00 00 00 02 32 fd 39 01 00 00 00 00 02 33 fc 39 01 00 00 00 00 02 34 fb 39 01 00 00 00 00 02 35 fa 39 01 00 00 00 00 02 36 f9 39 01 00 00 00 00 02 36 f9 39 01 00 00 00 00 02 37 f8 39 01 00 00 00 00 02 38 f7 39 01 00 00 00 00 02 39 f6 39 01 00 00 00 00 02 3a f4 39 01 00 00 00 00 02 3b f2 39 01 00 00 00 00 02 3d f0 39 01 00 00 00 00 02 3f ee 39 01 00 00 00 00 02 40 ea 39 01 00 00 00 00 02 41 e6 39 01 00 00 00 00 02 45 ff 39 01 00 00 00 00 02 46 fa 39 01 00 00 00 00 02 47 f5 39 01 00 00 00 00 02 48 f0 39 01 00 00 00 00 02 49 eb 39 01 00 00 00 00 02 4a e6 39 01 00 00 00 00 02 4b e1 39 01 00 00 00 00 02 4c dc 39 01 00 00 00 00 02 4d d7 39 01 00 00 00 00 02 4e d2 39 01 00 00 00 00 02 4f cd 39 01 00 00 00 00 02 50 c8 39 01 00 00 00 00 02 51 c3 39 01 00 00 00 00 02 52 be 39 01 00 00 00 00 02 53 b9 39 01 00 00 00 00 02 54 66 39 01 00 00 00 00 02 58 ff 39 01 00 00 00 00 02 59 fa 39 01 00 00 00 00 02 5a f5 39 01 00 00 00 00 02 5b f0 39 01 00 00 00 00 02 5c eb 39 01 00 00 00 00 02 5d e6 39 01 00 00 00 00 02 5e e1 39 01 00 00 00 00 02 5f dc 39 01 00 00 00 00 02 60 d7 39 01 00 00 00 00 02 61 d2 39 01 00 00 00 00 02 62 cd 39 01 00 00 00 00 02 63 c8 39 01 00 00 00 00 02 64 c3 39 01 00 00 00 00 02 65 be 39 01 00 00 00 00 02 66 b9 39 01 00 00 00 00 02 67 b4 39 01 00 00 00 00 02 ff 10 39 01 00 00 00 00 02 fb 01 39 01 00 00 00 00 03 5e 00 07 39 01 00 00 00 00 03 51 00 00 39 01 00 00 00 00 02 53 24 39 01 00 00 00 00 03 68 02 01 39 01 00 00 00 00 02 55 00 39 01 00 00 00 00 02 35 00 05 01 00 00 78 00 01 11 05 01 00 00 14 00 01 29];
				qcom,mdss-dsi-on-command-state = "dsi_lp_mode";
				qcom,mdss-dsi-panel-framerate = <0x78>;
				qcom,mdss-dsi-panel-height = <0x99c>;
				qcom,mdss-dsi-panel-phy-timings = [00 1f 08 07 18 16 08 08 08 02 04 00 1a 0d];
				qcom,mdss-dsi-panel-width = <0x438>;
				qcom,mdss-dsi-screen-off-command = <0x39010000 0x35e 0x3901 0x00 0x3510000>;
				qcom,mdss-dsi-screen-off-command-state = "dsi_lp_mode";
				qcom,mdss-dsi-screen-on-command = [39 01 00 00 00 00 02 ff 10 39 01 00 00 00 00 02 fb 01 39 01 00 00 00 00 02 53 2c];
				qcom,mdss-dsi-screen-on-command-state = "dsi_lp_mode";
				qcom,mdss-dsi-v-back-porch = <0x10>;
				qcom,mdss-dsi-v-front-porch = <0x36>;
				qcom,mdss-dsi-v-pulse-width = <0x04>;
				qcom,proximity_pre-off-command = [39 01 00 00 28 00 03 51 00 00 05 01 00 00 14 00 01 28];
				qcom,proximity_pre-off-command-state = "dsi_lp_mode";
			};
		};
	};
};
