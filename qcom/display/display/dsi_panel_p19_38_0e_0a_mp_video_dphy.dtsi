// SPDX-License-Identifier: BSD-3-Clause

&mdss_mdp {
	dsi_p19_38_0e_0a_mp_video_dphy: qcom,mdss_dsi_p19_38_0e_0a_mp_video_dphy {
		mi,doze-hbm-dbv-level = <0xaa>;
		mi,doze-lbm-dbv-level = <0x11>;
		mi,esd-err-irq-gpio = <&tlmm 0x5d 0x2008>;
		mi,esd-err-irq-gpio-flag = <0x2008>;
		mi,flatmode-status-check-enabled;
		mi,local-hbm-enabled;
		mi,local-hbm-ui-ready-delay-num-frame = <0x03>;
		mi,max-brightness-clone = <0xfff>;
		mi,mdss-dsi-fac-bl-max-level = <0x7ff>;
		mi,mdss-dsi-panel-cell-id-read-after-tx-command = [39 01 00 00 00 00 0b f0 a5 a5 00 00 00 00 00 00 00 00];
		mi,mdss-dsi-panel-cell-id-read-after-tx-command-state = "dsi_lp_mode";
		mi,mdss-dsi-panel-cell-id-read-command = <0x6010001 0x1d8>;
		mi,mdss-dsi-panel-cell-id-read-command-state = "dsi_lp_mode";
		mi,mdss-dsi-panel-cell-id-read-length = <0x08>;
		mi,mdss-dsi-panel-cell-id-read-offset1-command = [39 01 00 00 00 00 04 b0 00 12 d8];
		mi,mdss-dsi-panel-cell-id-read-offset1-command-state = "dsi_lp_mode";
		mi,mdss-dsi-panel-cell-id-read-offset2-command = [39 01 00 00 00 00 04 b0 00 1a d8];
		mi,mdss-dsi-panel-cell-id-read-offset2-command-state = "dsi_lp_mode";
		mi,mdss-dsi-panel-cell-id-read-pre-tx-command = [39 01 00 00 00 00 0b f0 5a 5a 00 00 00 00 00 00 00 00];
		mi,mdss-dsi-panel-cell-id-read-pre-tx-command-state = "dsi_lp_mode";
		mi,mdss-dsi-panel-flatmode-on-status-value = <0x29>;
		mi,mdss-dsi-panel-flatmode-status-command = <0x6010001 0x16a>;
		mi,mdss-dsi-panel-flatmode-status-command-state = "dsi_lp_mode";
		mi,mdss-dsi-panel-flatmode-status-offset-command = [39 01 00 40 00 00 0b f0 5a 5a 00 00 00 00 00 00 00 00 39 01 00 00 00 00 04 b0 00 03 6a];
		mi,mdss-dsi-panel-flatmode-status-offset-command-state = "dsi_lp_mode";
		mi,mdss-dsi-panel-flatmode-status-offset-end-command = [39 01 00 00 00 00 0b f0 a5 a5 00 00 00 00 00 00 00 00];
		mi,mdss-dsi-panel-flatmode-status-offset-end-command-state = "dsi_lp_mode";
		mi,mdss-dsi-panel-flatmode-status-read-length = <0x01>;
		mi,mdss-fac-brightness-max-level = <0x7ff>;
		mi,normal-max-brightness-clone = <0x7ff>;
		qcom,bl-dsc-cmd-state = "dsi_lp_mode";
		qcom,dsi-ctrl-num = <0x00>;
		qcom,dsi-phy-num = <0x00>;
		qcom,dsi-select-clocks = "pll_byte_clk0", "pll_dsi_clk0";
		qcom,dsi-supported-dfps-list = <0x78 0x5a 0x3c>;
		qcom,esd-check-enabled;
		qcom,mdss-brightness-init-level = <0x109>;
		/* Stock caps normal brightness at DBV 2047 (fac level), the rest is HBM */
		qcom,mdss-brightness-max-level = <2047>;
		qcom,mdss-dsi-bl-inverted-dbv;
		qcom,mdss-dsi-bl-max-level = <2047>;
		qcom,mdss-dsi-bl-min-level = <0x05>;
		qcom,mdss-dsi-bl-pmic-control-type = "bl_ctrl_dcs";
		qcom,mdss-dsi-bllp-eof-power-mode;
		qcom,mdss-dsi-bllp-power-mode;
		qcom,mdss-dsi-border-color = <0x00>;
		qcom,mdss-dsi-bpp = <0x18>;
		qcom,mdss-dsi-dma-schedule-line = <0x04>;
		qcom,mdss-dsi-dma-trigger = "trigger_sw";
		qcom,mdss-dsi-lane-0-state;
		qcom,mdss-dsi-lane-1-state;
		qcom,mdss-dsi-lane-2-state;
		qcom,mdss-dsi-lane-3-state;
		qcom,mdss-dsi-mdp-trigger = "none";
		qcom,mdss-dsi-pan-enable-dynamic-fps;
		qcom,mdss-dsi-pan-fps-update = "dfps_immediate_porch_mode_vfp";
		qcom,mdss-dsi-panel-name = "p19 38 0e 0a dphy AMS699MM01 SDC";
		qcom,mdss-dsi-panel-physical-type = "oled";
		qcom,mdss-dsi-panel-status-check-mode = "reg_read";
		qcom,mdss-dsi-panel-status-command = <0x6010001 0x19e>;
		qcom,mdss-dsi-panel-status-command-state = "dsi_hs_mode";
		qcom,mdss-dsi-panel-status-read-length = <0x02>;
		qcom,mdss-dsi-panel-status-value = <0x11 0x00>;
		qcom,mdss-dsi-panel-type = "dsi_video_mode";
		qcom,mdss-dsi-reset-sequence = <0x01 0x02 0x00 0x02 0x01 0x0a>;
		qcom,mdss-dsi-stream = <0x00>;
		qcom,mdss-dsi-traffic-mode = "burst_mode";
		qcom,mdss-dsi-virtual-channel-id = <0x00>;
		qcom,mdss-pan-physical-height-dimension = <0xa2>;
		qcom,mdss-pan-physical-width-dimension = <0x49>;
		qcom,platform-dvdd-gpio = <&tlmm 0x3c 0x00>;
		qcom,platform-reset-gpio = <&tlmm 0x5c 0x00>;
		qcom,platform-vci-gpio = <&tlmm 0x39 0x00>;
		qcom,platform-vddio-gpio = <&tlmm 0x5f 0x00>;
		qcom,mdss-dsi-display-timings {
			timing@0 {
				cell-index = <0x00>;
				mi,mdss-dsi-dimmingoff-command = [39 01 00 00 00 00 02 53 20];
				mi,mdss-dsi-dimmingoff-command-state = "dsi_hs_mode";
				mi,mdss-dsi-dimmingon-command = [39 01 00 00 00 00 02 53 28];
				mi,mdss-dsi-dimmingon-command-state = "dsi_hs_mode";
				mi,mdss-dsi-displayoff-command = [39 01 00 00 00 00 02 53 00];
				mi,mdss-dsi-displayoff-command-state = "dsi_lp_mode";
				mi,mdss-dsi-flat-mode-off-command = <0x39010000 0xbf0 0x5a5a0000 0x00 0x3901 0x00 0x4b00003 0x6a390100 0x02 0x6a093901 0x00 0xbf0a5a5 0x00 0x00>;
				mi,mdss-dsi-flat-mode-off-command-state = "dsi_lp_mode";
				mi,mdss-dsi-flat-mode-on-command = <0x39010000 0xbf0 0x5a5a0000 0x00 0x3901 0x00 0x4b00003 0x6a390100 0x02 0x6a293901 0x00 0xbf0a5a5 0x00 0x00>;
				mi,mdss-dsi-flat-mode-on-command-state = "dsi_lp_mode";
				mi,mdss-dsi-hbm-on-command = [39 01 00 00 00 00 03 51 0f ff];
				mi,mdss-dsi-hbm-on-command-state = "dsi_hs_mode";
				mi,mdss-dsi-local-hbm-hlpm-white-1000nit-command = <0x39010040 0xbf0 0x5a5a0000 0x00 0x3901 0x400000 0x36601f7 0x15010040 0x253 0x24390100 0x40000004 0xb0033b66 0x15010040 0x266 0x11390100 0x40000004 0xb0033c66 0x39010040 0xd66 0xa1a0908 0xb500a1b 0x9090b52 0x15010040 0x2f7 0x7150100 0x40000002 0xf7073901 0x00 0xbf0a5a5 0x00 0x00>;
				mi,mdss-dsi-local-hbm-hlpm-white-1000nit-command-state = "dsi_hs_mode";
				mi,mdss-dsi-local-hbm-hlpm-white-110nit-command = <0x39010040 0xbf0 0x5a5a0000 0x00 0x3901 0x400000 0x36601f7 0x15010040 0x253 0x24390100 0x40000004 0xb0033b66 0x15010040 0x266 0x11390100 0x40000004 0xb0033c66 0x39010040 0xd66 0x899079f 0x9aa08a2 0x7a109ac 0x15010040 0x2f7 0x7150100 0x40000002 0xf7073901 0x00 0xbf0a5a5 0x00 0x00>;
				mi,mdss-dsi-local-hbm-hlpm-white-110nit-command-state = "dsi_hs_mode";
				mi,mdss-dsi-local-hbm-normal-white-1000nit-command = <0x39010040 0xbf0 0x5a5a0000 0x00 0x3901 0x400000 0x36601f7 0x15010040 0x253 0x24390100 0x40000004 0xb0033b66 0x15010040 0x266 0x11390100 0x40000004 0xb0033c66 0x39010040 0xd66 0xa1a0908 0xb500a1b 0x9090b52 0x15010040 0x2f7 0x7150100 0x40000002 0xf7073901 0x00 0xbf0a5a5 0x00 0x00>;
				mi,mdss-dsi-local-hbm-normal-white-1000nit-command-state = "dsi_hs_mode";
				mi,mdss-dsi-local-hbm-normal-white-110nit-command = <0x39010040 0xbf0 0x5a5a0000 0x00 0x3901 0x400000 0x36601f7 0x15010040 0x253 0x24390100 0x40000004 0xb0033b66 0x15010040 0x266 0x11390100 0x40000004 0xb0033c66 0x39010040 0xd66 0x899079f 0x9aa08a2 0x7a109ac 0x15010040 0x2f7 0x7150100 0x40000002 0xf7073901 0x00 0xbf0a5a5 0x00 0x00>;
				mi,mdss-dsi-local-hbm-normal-white-110nit-command-state = "dsi_hs_mode";
				mi,mdss-dsi-local-hbm-off-to-normal-command = <0x39010040 0xbf0 0x5a5a0000 0x00 0x3901 0x400000 0x36601f7 0x15010040 0x253 0x20390100 0x40000004 0xb0033b66 0x15010040 0x266 0x1390100 0x40000004 0xb0033c66 0x39010040 0xd66 0x9dd08a1 0xaf109e5 0x8ab0afb 0x15010040 0x2f7 0x7150100 0x40000002 0xf7073901 0x00 0xbf0a5a5 0x00 0x00>;
				mi,mdss-dsi-local-hbm-off-to-normal-command-state = "dsi_hs_mode";
				mi,mdss-dsi-peak-mode-off-command = <0x39010040 0xbf0 0x5a5a0000 0x00 0x3901 0x400000 0x4b00001 0x6a390100 0x40000002 0x6a003901 0x400000 0x4b00010 0x6a390100 0x40000007 0x6a7571d7 0x26262639 0x1004000 0x4b000 0x776a3901 0x400000 0x36a0000 0x15010040 0x2f7 0x7150100 0x40000002 0xf7073901 0x00 0xbf0a5a5 0x00 0x00>;
				mi,mdss-dsi-peak-mode-off-command-state = "dsi_hs_mode";
				mi,mdss-dsi-peak-mode-on-command = <0x39010040 0xbf0 0x5a5a0000 0x00 0x3901 0x400000 0x4b00001 0x6a390100 0x40000002 0x6a023901 0x400000 0x4b00010 0x6a390100 0x40000007 0x6a6f6fdf 0x23232339 0x1004000 0x4b000 0x776a3901 0x400000 0x36ab994 0x15010040 0x2f7 0x7150100 0x40000002 0xf7073901 0x00 0xbf0a5a5 0x00 0x00>;
				mi,mdss-dsi-peak-mode-on-command-state = "dsi_hs_mode";
				qcom,compression-mode = "dsc";
				qcom,default-topology-index = <0x00>;
				qcom,display-topology = <0x01 0x01 0x01>;
				qcom,mdss-dsc-bit-per-component = <0x08>;
				qcom,mdss-dsc-bit-per-pixel = <0x08>;
				qcom,mdss-dsc-block-prediction-enable;
				qcom,mdss-dsc-scr-version = <0x00>;
				qcom,mdss-dsc-slice-height = <0x257>;
				qcom,mdss-dsc-slice-per-pkt = <0x02>;
				qcom,mdss-dsc-slice-width = <0x21c>;
				qcom,mdss-dsc-version = <0x11>;
				qcom,mdss-dsi-dispparam-120hz-command = [39 01 00 40 00 00 0b f0 5a 5a 00 00 00 00 00 00 00 00 15 01 00 40 00 00 02 60 00 39 01 00 40 00 00 2f c9 9a 60 60 00 00 00 00 00 00 00 00 00 00 00 00 00 00 00 00 00 00 00 01 00 00 00 00 00 00 00 00 00 00 00 00 00 00 78 3c 00 09 5c 00 0a 00 0a 39 01 00 40 00 00 04 b0 01 35 66 39 01 00 40 00 00 21 66 09 80 09 50 09 10 08 a0 08 38 07 c8 06 f0 06 18 05 38 04 60 03 88 02 b0 01 00 00 20 00 20 00 20 15 01 00 40 00 00 02 f7 0f 15 01 00 40 00 00 02 f7 0f 15 01 00 40 00 00 02 f7 0f 15 01 00 40 00 00 02 f7 0f 39 01 00 00 00 00 0b f0 a5 a5 00 00 00 00 00 00 00 00];
				qcom,mdss-dsi-dispparam-120hz-command-state = "dsi_hs_mode";
				qcom,mdss-dsi-dispparam-60hz-command = [39 01 00 40 00 00 0b f0 5a 5a 00 00 00 00 00 00 00 00 15 01 00 40 00 00 02 60 01 39 01 00 40 00 00 2f c9 9a 60 60 00 00 00 00 00 00 00 00 00 00 00 00 00 00 00 00 00 00 00 01 00 00 00 00 00 00 00 00 00 00 00 00 00 00 78 3c 00 09 5c 00 0a 00 0a 39 01 00 40 00 00 04 b0 01 35 66 39 01 00 40 00 00 21 66 09 80 09 50 09 10 08 a0 08 38 07 c8 06 f0 06 18 05 38 04 60 03 88 02 b0 01 00 00 20 00 20 00 20 15 01 00 40 00 00 02 f7 0f 15 01 00 40 00 00 02 f7 0f 15 01 00 40 00 00 02 f7 0f 15 01 00 40 00 00 02 f7 0f 39 01 00 00 00 00 0b f0 a5 a5 00 00 00 00 00 00 00 00];
				qcom,mdss-dsi-dispparam-60hz-command-state = "dsi_hs_mode";
				qcom,mdss-dsi-dispparam-90hz-command = [39 01 00 40 00 00 0b f0 5a 5a 00 00 00 00 00 00 00 00 15 01 00 40 00 00 02 60 00 39 01 00 40 00 00 2f c9 9a 60 60 00 00 00 00 00 00 00 00 00 00 00 00 00 00 00 00 00 00 00 01 00 00 00 00 00 00 00 00 00 00 00 00 00 00 78 3c 00 09 5c 03 2a 03 2a 39 01 00 40 00 00 04 b0 01 35 66 39 01 00 40 00 00 21 66 0c a0 0c 60 0c 0a 0b 78 0a ec 0a 58 09 38 08 10 06 f0 05 d0 04 b2 03 8a 01 58 00 2b 00 2b 00 2b 15 01 00 40 00 00 02 f7 0f 15 01 00 40 00 00 02 f7 0f 15 01 00 40 00 00 02 f7 0f 15 01 00 40 00 00 02 f7 0f 39 01 00 00 00 00 0b f0 a5 a5 00 00 00 00 00 00 00 00];
				qcom,mdss-dsi-dispparam-90hz-command-state = "dsi_hs_mode";
				qcom,mdss-dsi-dispparam-hbm-on-l1-command = [39 01 00 40 00 00 0b f0 5a 5a 00 00 00 00 00 00 00 00 39 01 00 40 00 00 0b f1 5a 5a 00 00 00 00 00 00 00 00 39 01 00 40 00 00 03 51 08 00 39 01 00 40 00 00 04 b0 00 5f f4 15 01 00 40 00 00 02 f4 0c 15 01 00 40 00 00 02 f7 07 15 01 00 40 00 00 02 f7 07 15 01 00 40 00 00 02 f7 07 39 01 00 40 00 00 0b f1 a5 a5 00 00 00 00 00 00 00 00 39 01 00 00 00 00 0b f0 a5 a5 00 00 00 00 00 00 00 00];
				qcom,mdss-dsi-dispparam-hbm-on-l1-command-state = "dsi_hs_mode";
				qcom,mdss-dsi-h-back-porch = <0x88>;
				qcom,mdss-dsi-h-front-porch = <0x64>;
				qcom,mdss-dsi-h-left-border = <0x00>;
				qcom,mdss-dsi-h-pulse-width = <0x22>;
				qcom,mdss-dsi-h-right-border = <0x00>;
				qcom,mdss-dsi-h-sync-skew = <0x00>;
				qcom,mdss-dsi-on-command = <0x39010000 0xb9f 0x5a5a0000 0x00 0x3901 0x00 0xbf05a5a 0x00 0x00 0x39010000 0xbfc 0x5a5a0000 0x00 0x3901 0x00 0x3d00100 0x39010000 0x4b0 0x53cd39 0x1000000 0x2cd08 0x5010000 0x64000111 0x39010000 0x28f 0xa390100 0x04 0xb000048f 0x39010000 0x28f 0xaf390100 0x10015 0xc7039503 0x4703c206 0xfc055c05 0x62001f01 0x3104451 0x22390100 0x0c 0xed00ff00 0xff0000 0x4000004 0x15010000 0x260 0x150100 0x02 0xf70f3901 0x00 0x2532839 0x1000000 0x4b000 0x10663901 0x00 0x2660139 0x1000000 0x4b000 0x12663901 0x00 0x2660839 0x1000000 0x35100 0x150100 0x02 0xf70f1501 0x00 0x29d0139 0x1000000 0x5a9e11 0x8930 0x80095c04 0x38025702 0x1c021c02 0x25200 0x20339e00 0x7000f00 0x34002c18 0x10f003 0xc200006 0xb0b330e 0x1c2a3846 0x54626970 0x77797b7d 0x7e010201 0x94009 0xbe19fc19 0xfa19f81a 0x381a781a 0xb62ab62a 0xf42af44b 0x34637400 0x15010000 0x14000235 0x390100 0x03 0x97010739 0x1000000 0x2f70f 0x5010000 0x14000129>;
				qcom,mdss-dsi-on-command-state = "dsi_lp_mode";
				qcom,mdss-dsi-panel-framerate = <0x78>;
				qcom,mdss-dsi-panel-height = <0x95c>;
				qcom,mdss-dsi-panel-phy-timings = [00 24 0a 0a 1a 18 0a 0a 09 02 04 00 1e 0f];
				qcom,mdss-dsi-panel-width = <0x438>;
				qcom,mdss-dsi-pre-off-command = [05 01 00 00 14 00 02 28 00 05 01 00 00 78 00 02 10 00];
				qcom,mdss-dsi-pre-off-command-state = "dsi_lp_mode";
				qcom,mdss-dsi-v-back-porch = <0x18>;
				qcom,mdss-dsi-v-bottom-border = <0x00>;
				qcom,mdss-dsi-v-front-porch = <0x0a>;
				qcom,mdss-dsi-v-pulse-width = <0x02>;
				qcom,mdss-dsi-v-top-border = <0x00>;
			};
		};
	};
};
