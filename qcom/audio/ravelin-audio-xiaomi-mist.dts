// SPDX-License-Identifier: BSD-3-Clause

/dts-v1/;
/plugin/;

#include "ravelin-audio-xiaomi-mist-common.dtsi"

/ {
	model = "Xiaomi Mist QRD";
	compatible = "qcom,ravelin-qrd", "qcom,ravelin", "qcom,qrd";
	qcom,msm-id = <568 0x10000>, <602 0x10000>, <653 0x10000>, <654 0x10000>;
	qcom,board-id = <0x1000B 0>, <0x1000B 0x600>;
};
