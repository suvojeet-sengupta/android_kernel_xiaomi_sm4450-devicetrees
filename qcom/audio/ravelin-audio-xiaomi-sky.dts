// SPDX-License-Identifier: BSD-3-Clause

/dts-v1/;
/plugin/;

#include "ravelin-audio-xiaomi-sky-common.dtsi"

/ {
	model = "Xiaomi Sky QRD";
	compatible = "qcom,ravelin-qrd", "qcom,ravelin", "qcom,qrd";
	qcom,msm-id = <568 0x10000>, <602 0x10000>;
	qcom,board-id = <0x1000B 0>, <0x1000B 0x600>;
};
