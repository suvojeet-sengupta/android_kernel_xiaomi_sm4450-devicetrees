// SPDX-License-Identifier: BSD-3-Clause
/*
 * Copyright (c) Qualcomm Technologies, Inc. and/or its subsidiaries.
 */

/dts-v1/;
/plugin/;

#include "montague-adrastea-overlay.dtsi"

/ {
	model = "Qualcomm Technologies, Inc. Ravelin IDP";
	compatible = "qcom,ravelin-idp", "qcom,ravelin", "qcom,idp";
	qcom,msm-id = <734 0x10000>;
	qcom,board-id = <34 0>, <34 0x600>, <34 2>, <0x10022 0x4>, <0x10022 3>,
			<0x10022 0x5>, <0x10022 0x8>, <0x10022 0x9>, <0x10022 0x0>;
};
